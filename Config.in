## Config.in
```kconfig
source "$BR2_EXTERNAL_PLUTOSDR_PATH/package/board-fpga/Config.in"
source "$BR2_EXTERNAL_PLUTOSDR_PATH/package/trxd/Config.in"
source "$BR2_EXTERNAL_PLUTOSDR_PATH/package/ffmpeg-aac/Config.in"
```

## board/tezuka/pluto/plutomaia.its
```
/*
 * FIT for the ADALM-Pluto (tezuka_fw_simple BASIC, docs/FLAVOURS.md): three
 * device trees (Rev A, B, C; U-Boot's adi_hwref picks the configuration),
 * the gzip bitstream, the lzma kernel and the xz rootfs, as on PlutoSky R2.
 */

/dts-v1/;

/ {
	description = "Configuration to load fpga before Kernel";
	magic = "ITB PlutoSDR (ADALM-PLUTO)";
	#address-cells = <1>;
	images {

		fdt@1 {
			description = "zynq-pluto-sdr";
			data = /incbin/("zynq-pluto-sdr.dtb");
			type = "flat_dt";
			arch = "arm";
			compression = "none";
			/* No hash: U-Boot's adi_loadvals edits this blob in place
			 * inside the loaded FIT (fdt set/rm), so bootm would reject it. */
		};

		fdt@2 {
			description = "zynq-pluto-sdr-revb";
			data = /incbin/("zynq-pluto-sdr-revb.dtb");
			type = "flat_dt";
			arch = "arm";
			compression = "none";
		};

		fdt@3 {
			description = "zynq-pluto-sdr-revc";
			data = /incbin/("zynq-pluto-sdr-revc.dtb");
			type = "flat_dt";
			arch = "arm";
			compression = "none";
		};

		fpga@1 {
			description = "FPGA";
			/* gzip: U-Boot decompresses FPGA images to their load address. */
			data = /incbin/("system_top.bit.gz");
			type = "fpga";
			arch = "arm";
			compression = "gzip";
			compatible = "u-boot,fpga-legacy";
			load = <0xF000000>;
			hash@1 {
				algo = "md5";
			};
		};

		linux_kernel@1 {
			description = "Linux";
			/* lzma: smaller than zImage, decompressed by U-Boot itself
			 * (tezuka issue #450). */
			data = /incbin/("Image.lzma");
			type = "kernel";
			arch = "arm";
			os = "linux";
			compression = "lzma";
			load = <0x8000>;
			entry = <0x8000>;
			hash@1 {
				algo = "md5";
			};
		};
		ramdisk@1 {
			description = "Ramdisk";
			data = /incbin/("rootfs.cpio.xz");
			type = "ramdisk";
			arch = "arm";
			os = "linux";
			compression = "none";
			hash@1 {
				algo = "md5";
			};
		};

	};

	configurations {
		default = "config@0";
		config@0 {
			description = "Linux with fpga RevA";
			fdt = "fdt@1";
			kernel = "linux_kernel@1";
			ramdisk = "ramdisk@1";
			fpga = "fpga@1";
		};

		/* all below is currently RevB ! */

		config@1 {
			description = "Linux with fpga RevB";
			fdt = "fdt@2";
			kernel = "linux_kernel@1";
			ramdisk = "ramdisk@1";
			fpga = "fpga@1";
		};

		config@2 {
			description = "Linux with fpga RevB";
			fdt = "fdt@2";
			kernel = "linux_kernel@1";
			ramdisk = "ramdisk@1";
			fpga = "fpga@1";
		};

		config@3 {
			description = "Linux with fpga RevB";
			fdt = "fdt@2";
			kernel = "linux_kernel@1";
			ramdisk = "ramdisk@1";
			fpga = "fpga@1";
		};

		config@4 {
			description = "Linux with fpga RevB";
			fdt = "fdt@2";
			kernel = "linux_kernel@1";
			ramdisk = "ramdisk@1";
			fpga = "fpga@1";
		};

		config@5 {
			description = "Linux with fpga RevB";
			fdt = "fdt@2";
			kernel = "linux_kernel@1";
			ramdisk = "ramdisk@1";
			fpga = "fpga@1";
		};

		config@6 {
			description = "Linux with fpga RevB";
			fdt = "fdt@2";
			kernel = "linux_kernel@1";
			ramdisk = "ramdisk@1";
			fpga = "fpga@1";
		};


		config@7 {
			description = "Linux with fpga RevB";
			fdt = "fdt@2";
			kernel = "linux_kernel@1";
			ramdisk = "ramdisk@1";
			fpga = "fpga@1";
		};

		config@8 { /* This one is actually RevC */
			description = "Linux with fpga RevC";
			fdt = "fdt@3";
			kernel = "linux_kernel@1";
			ramdisk = "ramdisk@1";
			fpga = "fpga@1";
		};

		config@9 { /* This one is actually RevB */
			description = "Linux with fpga RevB";
			fdt = "fdt@2";
			kernel = "linux_kernel@1";
			ramdisk = "ramdisk@1";
			fpga = "fpga@1";
		};

		config@10 {
			description = "Linux with fpga RevB";
			fdt = "fdt@2";
			kernel = "linux_kernel@1";
			ramdisk = "ramdisk@1";
			fpga = "fpga@1";
		};
	};
};
```

## package/board-fpga/Config.in
```kconfig
config BR2_PACKAGE_BOARD_FPGA
	bool "board-fpga"
	help
	  Install pre-built FPGA bitstream for the target board.

config BR2_PACKAGE_BOARD_FPGA_BOARD
	string "Board name for bitstream path"
	depends on BR2_PACKAGE_BOARD_FPGA
	help
	  Name of the board directory under board/tezuka/ containing
	  the bitstream in bitstream/<project>.xsa (see
	  BR2_PACKAGE_BOARD_FPGA_PROJECT for <project>).
	  Examples: pluto, plutoplus, e200, fishball7010, fishball7020

config BR2_PACKAGE_BOARD_FPGA_PROJECT
	string "Bitstream project name"
	default "tezuka"
	depends on BR2_PACKAGE_BOARD_FPGA
	help
	  Name of the maia-hdl project that produced the bitstream, used as
	  the .xsa filename: board/tezuka/<board>/bitstream/<project>.xsa.
	  Most boards use the default "tezuka" project; boards built from a
	  different maia-hdl project (e.g. "ka9q") should set this to match.

config BR2_PACKAGE_BOARD_FPGA_MODES
	string "FPGA modes to install"
	default ""
	depends on BR2_PACKAGE_BOARD_FPGA
	help
	  Space-separated FPGA modes (docs/FPGA-MODES.md) the image carries:
	  "trx" for the BASIC flavour, empty for every <project>-<mode>.xsa
	  the board has (BASIC+). The boot mode is always included.

config BR2_PACKAGE_BOARD_FPGA_FLAVOUR
	string "Firmware flavour"
	default ""
	depends on BR2_PACKAGE_BOARD_FPGA
	help
	  basic or plus (docs/FLAVOURS.md); written to /etc/fw-flavour and
	  into the image's VERSION.
```

## package/ffmpeg-aac/Config.in
```kconfig
config BR2_PACKAGE_FFMPEG_AAC
	bool "ffmpeg-aac"
	help
	  A minimal static libavcodec + libavutil for trxd's DATV audio:
	  the Opus decoder and the AAC-LC encoder only (the browser sends
	  Opus, the transport stream carries AAC-LC in ADTS, as DVB
	  receivers expect). No programs, no shared libraries: only the
	  code trxd calls ends up in the image. LGPL-2.1+.
```

## package/trxd/Config.in
```kconfig
config BR2_PACKAGE_TRXD
	bool "trxd"
	help
	  Headless AD936x transceiver (TCI + rigctld, Q65/PI4/CW
	  decoders) and IARU-R1 MGM beacon transmitter/receiver
	  (decodes to the log). Source: src/trxd in this tree.

	  Built with the host's rustup toolchain pinned by
	  src/trxd/rust-toolchain.toml (Buildroot's Rust is too old for
	  its dependencies), so rustup must be installed on the build
	  machine.
```
